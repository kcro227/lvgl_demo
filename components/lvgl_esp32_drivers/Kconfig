## components/lvgl_esp32_drivers/Kconfig
```kconfig
menu "LVGL ESP Drivers"

    rsource "lvgl_tft/Kconfig"


endmenu

menu "I2C Port Settings"
    depends on LV_I2C && !HAVE_I2C_MANAGER

    rsource "lvgl_i2c/Kconfig"

endmenu
```
